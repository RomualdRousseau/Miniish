APU_CTRL	  = $740A
APU_STATUS	  = $740B
APU_CTRL_WAV0 = $7400
APU_CTRL_ENV0 = $7401
APU_CTRL_LEN0 = $7402
APU_CTRL_MOD0 = $7403
APU_NOTE0	  = $7404
APU_CTRL_WAV1 = $7410
APU_CTRL_ENV1 = $7411
APU_CTRL_LEN1 = $7412
APU_CTRL_MOD1 = $7413
APU_NOTE1	  = $7414
APU_CTRL_WAV2 = $7420
APU_CTRL_ENV2 = $7421
APU_CTRL_LEN2 = $7422
APU_CTRL_MOD2 = $7423
APU_NOTE2	  = $7424
APU_CTRL_WAV3 = $7430
APU_CTRL_ENV3 = $7431
APU_CTRL_LEN3 = $7432
APU_CTRL_MOD3 = $7433
APU_NOTE3	  = $7434

APU_SINE	  = $00
APU_TRIANGLE  = $01
APU_SQUARE	  = $02
APU_SAW	      = $03
APU_RAMP	  = $04
APU_NOISE	  = $05
  
APU_ENVELOPE0 = $00
APU_ENVELOPE1 = $01
APU_ENVELOPE2 = $02
APU_ENVELOPE3 = $03

APU_NEUTRAL   = $40
